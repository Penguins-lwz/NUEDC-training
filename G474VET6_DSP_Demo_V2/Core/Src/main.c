/* USER CODE BEGIN Header */
/**
  ******************************************************************************
  * @file           : main.c
  * @brief          : Main program body
  ******************************************************************************
  * @attention
  *
  * Copyright (c) 2024 STMicroelectronics.
  * All rights reserved.
  *
  * This software is licensed under terms that can be found in the LICENSE file
  * in the root directory of this software component.
  * If no LICENSE file comes with this software, it is provided AS-IS.
  *
  ******************************************************************************
  */
/* USER CODE END Header */
/* Includes ------------------------------------------------------------------*/
#include "main.h"
#include "dma.h"
#include "usart.h"
#include "gpio.h"

/* Private includes ----------------------------------------------------------*/
/* USER CODE BEGIN Includes */
#include "fir.h"
#include "fft.h"

/* USER CODE END Includes */

/* Private typedef -----------------------------------------------------------*/
/* USER CODE BEGIN PTD */

/* USER CODE END PTD */

/* Private define ------------------------------------------------------------*/
/* USER CODE BEGIN PD */

/* USER CODE END PD */

/* Private macro -------------------------------------------------------------*/
/* USER CODE BEGIN PM */

/* USER CODE END PM */

/* Private variables ---------------------------------------------------------*/

/* USER CODE BEGIN PV */
myUART_HandleTypeDef UART_Debug = { .huart = &huart1, .RxMsgUsed = true };

const float32_t FIR_Src[FIR_DATA_SIZE] = {
	97.37595, 102.8701, 107.0632, 115.7156, 112.8137, 120.9769, 131.8534, 135.8663,
	136.6982, 140.7686, 135.6568, 149.9058, 164.5603, 158.7260, 161.0878, 157.4640,
	172.9973, 170.6156, 176.1572, 182.5258, 178.3203, 181.0249, 182.6125, 178.3821,
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	173.0982, 167.2959, 166.8559, 178.2473, 172.5712, 185.4050, 183.7084, 186.7897
};

float32_t FIR_Dst[FIR_DATA_SIZE];
float32_t FFT_Src[FFT_DATA_SIZE];
float32_t FFT_Dst[FFT_DATA_SIZE];

/* USER CODE END PV */

/* Private function prototypes -----------------------------------------------*/
void SystemClock_Config(void);
/* USER CODE BEGIN PFP */
void ALGO_FIR_Demo(void);
void ALGO_FFT_Demo_1(void);
void ALGO_FFT_Demo_2(void);

/* USER CODE END PFP */

/* Private user code ---------------------------------------------------------*/
/* USER CODE BEGIN 0 */

/* USER CODE END 0 */

/**
  * @brief  The application entry point.
  * @retval int
  */
int main(void)
{

  /* USER CODE BEGIN 1 */

  /* USER CODE END 1 */

  /* MCU Configuration--------------------------------------------------------*/

  /* Reset of all peripherals, Initializes the Flash interface and the Systick. */
  HAL_Init();

  /* USER CODE BEGIN Init */

  /* USER CODE END Init */

  /* Configure the system clock */
  SystemClock_Config();

  /* USER CODE BEGIN SysInit */

  /* USER CODE END SysInit */

  /* Initialize all configured peripherals */
  MX_GPIO_Init();
  MX_DMA_Init();
  MX_USART1_UART_Init();
  /* USER CODE BEGIN 2 */
  /* Choose demos ------------------------------------------------------------*/
  ALGO_FIR_Demo();
  ALGO_FFT_Demo_1();
  ALGO_FFT_Demo_2();
  
  /* USER CODE END 2 */

  /* Infinite loop */
  /* USER CODE BEGIN WHILE */
  while (1)
  {
    /* USER CODE END WHILE */

    /* USER CODE BEGIN 3 */
  }
  /* USER CODE END 3 */
}

/**
  * @brief System Clock Configuration
  * @retval None
  */
void SystemClock_Config(void)
{
  RCC_OscInitTypeDef RCC_OscInitStruct = {0};
  RCC_ClkInitTypeDef RCC_ClkInitStruct = {0};

  /** Configure the main internal regulator output voltage
  */
  HAL_PWREx_ControlVoltageScaling(PWR_REGULATOR_VOLTAGE_SCALE1_BOOST);

  /** Initializes the RCC Oscillators according to the specified parameters
  * in the RCC_OscInitTypeDef structure.
  */
  RCC_OscInitStruct.OscillatorType = RCC_OSCILLATORTYPE_HSE;
  RCC_OscInitStruct.HSEState = RCC_HSE_ON;
  RCC_OscInitStruct.PLL.PLLState = RCC_PLL_ON;
  RCC_OscInitStruct.PLL.PLLSource = RCC_PLLSOURCE_HSE;
  RCC_OscInitStruct.PLL.PLLM = RCC_PLLM_DIV6;
  RCC_OscInitStruct.PLL.PLLN = 85;
  RCC_OscInitStruct.PLL.PLLP = RCC_PLLP_DIV2;
  RCC_OscInitStruct.PLL.PLLQ = RCC_PLLQ_DIV2;
  RCC_OscInitStruct.PLL.PLLR = RCC_PLLR_DIV2;
  if (HAL_RCC_OscConfig(&RCC_OscInitStruct) != HAL_OK)
  {
    Error_Handler();
  }

  /** Initializes the CPU, AHB and APB buses clocks
  */
  RCC_ClkInitStruct.ClockType = RCC_CLOCKTYPE_HCLK|RCC_CLOCKTYPE_SYSCLK
                              |RCC_CLOCKTYPE_PCLK1|RCC_CLOCKTYPE_PCLK2;
  RCC_ClkInitStruct.SYSCLKSource = RCC_SYSCLKSOURCE_PLLCLK;
  RCC_ClkInitStruct.AHBCLKDivider = RCC_SYSCLK_DIV1;
  RCC_ClkInitStruct.APB1CLKDivider = RCC_HCLK_DIV1;
  RCC_ClkInitStruct.APB2CLKDivider = RCC_HCLK_DIV1;

  if (HAL_RCC_ClockConfig(&RCC_ClkInitStruct, FLASH_LATENCY_4) != HAL_OK)
  {
    Error_Handler();
  }
}

/* USER CODE BEGIN 4 */
void ALGO_FIR_Demo(void)
{
	// The original signal is suppose to be
	// f(t) = 100 + 80 * sin(0.02 * PI * t) + 5 * GaussianNoise,
	// which means the main frequency is wd = 0.02.
	// Ex. Fs = 1 MHz, f = 10 kHz, Vpp = 160 V, Vbias = 100 V.
	FIR_f32((float32_t *)FIR_Src, FIR_Dst);
	
	// Print waveforms before and after filtering. Pay attention to group delay.
	for (uint16_t i = 0; i < FIR_DATA_SIZE - FIR_NUM_TAPS / 2; ++i)
		myUART_Transmit_DMA(&UART_Debug, "FIR[%d]: %.3f, %.3f\n", i, FIR_Src[i], FIR_Dst[i + FIR_NUM_TAPS / 2]);
}

void ALGO_FFT_Demo_1(void)
{
	// Demo data 1 for integral period (without leakage of frequency spectrum)
	for (uint16_t i = 0; i < FFT_DATA_SIZE; ++i)
		FFT_Src[i] = 100,
		FFT_Src[i] += 75 * arm_cos_f32( 2 * PI / FFT_DATA_SIZE * i),
		FFT_Src[i] += 20 * arm_cos_f32( 6 * PI / FFT_DATA_SIZE * i +  60 * PI / 180),
		FFT_Src[i] += 10 * arm_cos_f32(12 * PI / FFT_DATA_SIZE * i - 135 * PI / 180);
	
	// To remove meaningless part, phases with amplitudes below the threshold will be set to 0.
	RFFT_f32(FFT_Src, FFT_Dst, 5e-4);
	
	// Print both amplitude spectrum and phase spectrum simultaneously.
	for (uint16_t i = 0; i < FFT_DATA_SIZE / 2; ++i)
		myUART_Transmit_DMA(&UART_Debug, "FFT[%d]: %.3f, %.3f\n", i, FFT_Dst[i], FFT_Dst[i + FFT_DATA_SIZE / 2] * (180 / PI));
}

void ALGO_FFT_Demo_2(void)
{
	// Demo data 2 for non-integral period (with leakage of frequency spectrum)
	for (uint16_t i = 0; i < FFT_DATA_SIZE; ++i)
		FFT_Src[i] = 100 + 75 * arm_cos_f32(2 * PI / 1000 * i);
	
	// To remove meaningless part, phases with amplitudes below the threshold will be set to 0.
	RFFT_f32(FFT_Src, FFT_Dst, 5e-4);
	
	// Print both amplitude spectrum and phase spectrum simultaneously.
	for (uint16_t i = 0; i < FFT_DATA_SIZE / 2; ++i)
		myUART_Transmit_DMA(&UART_Debug, "FFT[%d]: %.3f, %.3f\n", i, FFT_Dst[i], FFT_Dst[i + FFT_DATA_SIZE / 2] * (180 / PI));
}

/* USER CODE END 4 */

/**
  * @brief  This function is executed in case of error occurrence.
  * @retval None
  */
void Error_Handler(void)
{
  /* USER CODE BEGIN Error_Handler_Debug */
  /* User can add his own implementation to report the HAL error return state */
  __disable_irq();
  while (1)
  {
  }
  /* USER CODE END Error_Handler_Debug */
}

#ifdef  USE_FULL_ASSERT
/**
  * @brief  Reports the name of the source file and the source line number
  *         where the assert_param error has occurred.
  * @param  file: pointer to the source file name
  * @param  line: assert_param error line source number
  * @retval None
  */
void assert_failed(uint8_t *file, uint32_t line)
{
  /* USER CODE BEGIN 6 */
  /* User can add his own implementation to report the file name and line number,
     ex: printf("Wrong parameters value: file %s on line %d\r\n", file, line) */
  /* USER CODE END 6 */
}
#endif /* USE_FULL_ASSERT */
