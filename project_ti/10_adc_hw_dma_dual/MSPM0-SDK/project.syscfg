/**
 * @cliArgs --board "/ti/boards/LP_MSPM0G3507" --product "mspm0_sdk@2.03.00.07"
 * @versions {"tool":"1.22.0+3893"}
 */

/**
 * Import the modules used in this configuration.
 */
const ADC12  = scripting.addModule("/ti/driverlib/ADC12", {}, false);
const ADC121 = ADC12.addInstance();
const ADC122 = ADC12.addInstance();
const GPIO   = scripting.addModule("/ti/driverlib/GPIO", {}, false);
const GPIO1  = GPIO.addInstance();
const GPIO2  = GPIO.addInstance();
const SYSCTL = scripting.addModule("/ti/driverlib/SYSCTL");
const TIMER  = scripting.addModule("/ti/driverlib/TIMER", {}, false);
const TIMER1 = TIMER.addInstance();
const TIMER2 = TIMER.addInstance();
const UART   = scripting.addModule("/ti/driverlib/UART", {}, false);
const UART1  = UART.addInstance();

/**
 * Write custom configuration values to the imported modules.
 */
const divider9       = system.clockTree["UDIV"];
divider9.divideValue = 2;

const multiplier2         = system.clockTree["PLL_QDIV"];
multiplier2.multiplyValue = 4;

const mux4       = system.clockTree["EXHFMUX"];
mux4.inputSelect = "EXHFMUX_XTAL";

const mux8       = system.clockTree["HSCLKMUX"];
mux8.inputSelect = "HSCLKMUX_SYSPLL0";

const mux12       = system.clockTree["SYSPLLMUX"];
mux12.inputSelect = "zSYSPLLMUX_HFCLK";

const pinFunction4       = system.clockTree["HFXT"];
pinFunction4.inputFreq   = 40;
pinFunction4.enable      = true;
pinFunction4.HFXTStartup = 8;

ADC121.$name                             = "ADC0";
ADC121.sampClkSrc                        = "DL_ADC12_CLOCK_ULPCLK";
ADC121.repeatMode                        = true;
ADC121.trigSrc                           = "DL_ADC12_TRIG_SRC_EVENT";
ADC121.adcMem0_name                      = "CH0";
ADC121.adcMem0trig                       = "DL_ADC12_TRIGGER_MODE_TRIGGER_NEXT";
ADC121.powerDownMode                     = "DL_ADC12_POWER_DOWN_MODE_MANUAL";
ADC121.sampleTime0                       = "750 ns";
ADC121.enabledInterrupts                 = ["DL_ADC12_INTERRUPT_DMA_DONE"];
ADC121.interruptPriority                 = "0";
ADC121.configureDMA                      = true;
ADC121.sampCnt                           = 1;
ADC121.enabledDMATriggers                = ["DL_ADC12_DMA_MEM0_RESULT_LOADED"];
ADC121.subChanID                         = 1;
ADC121.peripheral.$assign                = "ADC0";
ADC121.peripheral.adcPin0.$assign        = "boosterpack.8";
ADC121.adcPin0Config.hideOutputInversion = scripting.forceWrite(false);
ADC121.adcPin0Config.$name               = "ti_driverlib_gpio_GPIOPinGeneric2";
ADC121.DMA_CHANNEL.$name                 = "DMA_CH0";
ADC121.DMA_CHANNEL.addressMode           = "f2b";
ADC121.DMA_CHANNEL.srcLength             = "HALF_WORD";
ADC121.DMA_CHANNEL.dstLength             = "HALF_WORD";
ADC121.DMA_CHANNEL.peripheral.$assign    = "DMA_CH0";

ADC122.$name                          = "ADC1";
ADC122.sampClkSrc                     = "DL_ADC12_CLOCK_ULPCLK";
ADC122.repeatMode                     = true;
ADC122.trigSrc                        = "DL_ADC12_TRIG_SRC_EVENT";
ADC122.adcMem0_name                   = "CH1";
ADC122.adcMem0chansel                 = "DL_ADC12_INPUT_CHAN_1";
ADC122.adcMem0trig                    = "DL_ADC12_TRIGGER_MODE_TRIGGER_NEXT";
ADC122.powerDownMode                  = "DL_ADC12_POWER_DOWN_MODE_MANUAL";
ADC122.sampleTime0                    = "750 ns";
ADC122.configureDMA                   = true;
ADC122.sampCnt                        = 1;
ADC122.enabledDMATriggers             = ["DL_ADC12_DMA_MEM0_RESULT_LOADED"];
ADC122.subChanID                      = 2;
ADC122.peripheral.$assign             = "ADC1";
ADC122.peripheral.adcPin1.$assign     = "boosterpack.29";
ADC122.adcPin1Config.$name            = "ti_driverlib_gpio_GPIOPinGeneric3";
ADC122.DMA_CHANNEL.$name              = "DMA_CH1";
ADC122.DMA_CHANNEL.addressMode        = "f2b";
ADC122.DMA_CHANNEL.srcLength          = "HALF_WORD";
ADC122.DMA_CHANNEL.dstLength          = "HALF_WORD";
ADC122.DMA_CHANNEL.peripheral.$assign = "DMA_CH1";

const Board                       = scripting.addModule("/ti/driverlib/Board", {}, false);
Board.peripheral.$assign          = "DEBUGSS";
Board.peripheral.swclkPin.$assign = "j25_expansion.16";
Board.peripheral.swdioPin.$assign = "j25_expansion.14";

GPIO1.$name                               = "LED";
GPIO1.associatedPins.create(3);
GPIO1.associatedPins[0].$name             = "R";
GPIO1.associatedPins[0].launchPadShortcut = "LED2RedEn";
GPIO1.associatedPins[1].$name             = "G";
GPIO1.associatedPins[1].launchPadShortcut = "LED2GreenEn";
GPIO1.associatedPins[2].$name             = "B";
GPIO1.associatedPins[2].launchPadShortcut = "LED2BlueEn";

GPIO2.$name                               = "KEY";
GPIO2.associatedPins.create(2);
GPIO2.associatedPins[0].$name             = "S1";
GPIO2.associatedPins[0].launchPadShortcut = "Button2En";
GPIO2.associatedPins[0].internalResistor  = "NONE";
GPIO2.associatedPins[1].$name             = "S2";
GPIO2.associatedPins[1].launchPadShortcut = "Button3En";

SYSCTL.forceDefaultClkConfig = true;
SYSCTL.clockTreeEn           = true;

TIMER1.$name              = "TIM_KEY";
TIMER1.timerClkPrescale   = 40;
TIMER1.timerMode          = "PERIODIC_UP";
TIMER1.timerPeriod        = "10 ms";
TIMER1.interrupts         = ["ZERO"];
TIMER1.interruptPriority  = "3";
TIMER1.peripheral.$assign = "TIMG0";

TIMER2.$name                       = "TIM_ADC";
TIMER2.timerClkPrescale            = 10;
TIMER2.timerMode                   = "PERIODIC_UP";
TIMER2.timerPeriod                 = "1 us";
TIMER2.event1PublisherChannel      = 1;
TIMER2.event1ControllerInterruptEn = ["ZERO_EVENT"];
TIMER2.event2PublisherChannel      = 2;
TIMER2.event2ControllerInterruptEn = ["ZERO_EVENT"];
TIMER2.peripheral.$assign          = "TIMG8";

UART1.$name                            = "UART_DEBUG";
UART1.targetBaudRate                   = 115200;
UART1.enabledInterrupts                = ["RX"];
UART1.interruptPriority                = "1";
UART1.peripheral.$assign               = "UART0";
UART1.peripheral.rxPin.$assign         = "boosterpack.33";
UART1.peripheral.txPin.$assign         = "boosterpack.34";
UART1.txPinConfig.direction            = scripting.forceWrite("OUTPUT");
UART1.txPinConfig.hideOutputInversion  = scripting.forceWrite(false);
UART1.txPinConfig.onlyInternalResistor = scripting.forceWrite(false);
UART1.txPinConfig.passedPeripheralType = scripting.forceWrite("Digital");
UART1.txPinConfig.$name                = "ti_driverlib_gpio_GPIOPinGeneric0";
UART1.rxPinConfig.hideOutputInversion  = scripting.forceWrite(false);
UART1.rxPinConfig.onlyInternalResistor = scripting.forceWrite(false);
UART1.rxPinConfig.passedPeripheralType = scripting.forceWrite("Digital");
UART1.rxPinConfig.$name                = "ti_driverlib_gpio_GPIOPinGeneric1";

const ProjectConfig              = scripting.addModule("/ti/project_config/ProjectConfig", {}, false);
ProjectConfig.migrationCondition = true;

/**
 * Pinmux solution for unlocked pins/peripherals. This ensures that minor changes to the automatic solver in a future
 * version of the tool will not impact the pinmux you originally saw.  These lines can be completely deleted in order to
 * re-solve from scratch.
 */
pinFunction4.peripheral.$suggestSolution           = "SYSCTL";
pinFunction4.peripheral.hfxInPin.$suggestSolution  = "j17_expansion.4";
pinFunction4.peripheral.hfxOutPin.$suggestSolution = "j17_expansion.5";
GPIO1.associatedPins[0].pin.$suggestSolution       = "j19_expansion.8";
GPIO1.associatedPins[1].pin.$suggestSolution       = "j19_expansion.10";
GPIO1.associatedPins[2].pin.$suggestSolution       = "j19_expansion.5";
GPIO2.associatedPins[0].pin.$suggestSolution       = "boosterpack.26";
GPIO2.associatedPins[1].pin.$suggestSolution       = "j19_expansion.4";
